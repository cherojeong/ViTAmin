VERSION ""

NS_ :

BS_:

BU_:

BO_ 21 ViTAmin_A: 4 Vector__XXX
 SG_ Vi_VehicleSpeed : 7|16@0+ (0.01,0) [0|320] "kph" Vector__XXX
 SG_ Vi_Indicator : 18|2@1+ (1,0) [0|0] "" Vector__XXX
